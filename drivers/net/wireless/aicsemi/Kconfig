## drivers/net/wireless/aicsemi/Kconfig
```kconfig
# SPDX-License-Identifier: GPL-2.0-only

config WLAN_VENDOR_AICSEMI
	bool "AICSemi devices"
	default y
	help
	  Say Y here to see configuration options for AICSemi wireless
	  devices. This option does not build a driver by itself.

if WLAN_VENDOR_AICSEMI

source "drivers/net/wireless/aicsemi/aic8800/Kconfig"

endif # WLAN_VENDOR_AICSEMI
```

## drivers/net/wireless/aicsemi/aic8800/Kconfig
```kconfig
# SPDX-License-Identifier: GPL-2.0-only

config AIC8800_USB
	tristate "AICSemi AIC8800 USB support"
	depends on USB
	depends on CFG80211
	select FW_LOADER
	help
	  This driver supports USB variants of the AICSemi AIC8800 family,
	  including the AIC8800D80 used on the Radxa ROCK 4D.

	  Two modules are built: aic_load_fw loads the device firmware and
	  aic8800_fdrv provides the cfg80211 network interface.
```
